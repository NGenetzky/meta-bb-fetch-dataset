## meta-com-github/conf/layer.conf
```bitbake
# We do not have a conf and classes directory.
# BBPATH .= ":${LAYERDIR}"

# We have example recipes right in LAYERDIR.
BBFILES += "${LAYERDIR}/recipes/*/*.bb"

#   meta-bb-project-base:
#     url: "https://gitlab.com/ngenetzky/meta-bb-project-base.git"
#     refspec: "488de59a971b769cbe059e041c495600311abf8b"
#     path: "build/layers/meta-bb-project-base/"
#     layers:
#       meta-r0-base:
#       meta-r1-bb:
LAYERSERIES_COMPAT_bb-fetch-dataset-com-github = "734fb250-c268-11ea-9adc-5986b46143b2"

# We do not have recipes to put in a collection
BBFILE_COLLECTIONS += "bb-fetch-dataset-com-github"
BBFILE_PATTERN_bb-fetch-dataset-com-github = "^${LAYERDIR}/"
BBFILE_PRIORITY_bb-fetch-dataset-com-github = "6"
```
